#include <Wire.h>
#include <Adafruit_GFX.h>
#include <Adafruit_SSD1306.h>
#include "SdFat.h"
#include <vector>
#include <string>
#include <sstream>

// Define the screen dimensions
#define SCREEN_WIDTH 128
#define SCREEN_HEIGHT 64

// Define the I2C pins
#define OLED_SDA 0
#define OLED_SCL 1

// Create an SSD1306 display object
Adafruit_SSD1306 display(SCREEN_WIDTH, SCREEN_HEIGHT, &Wire, -1);

// Pin definitions for the rotary encoder
#define ROTARY_PIN_A 18
#define ROTARY_PIN_B 22
#define BUTTON_PIN   17

#if SPI_DRIVER_SELECT == 2  // Must be set in SdFat/SdFatConfig.h

// SD_FAT_TYPE = 0 for SdFat/File as defined in SdFatConfig.h,
// 1 for FAT16/FAT32, 2 for exFAT, 3 for FAT16/FAT32 and exFAT.
#define SD_FAT_TYPE 3


// Pin definitions
const int ledPin = LED_BUILTIN;
const int buttonPin = 16; // Adjust based on your wiring

// Variables
unsigned long lastDebounceTime = 0;
unsigned long debounceDelay = 50;
bool ledState = false;
int lastButtonState = HIGH;

// Chip select may be constant or RAM variable.
const uint8_t SD_CS_PIN = 4;

// Pin numbers in templates must be constants.
const uint8_t SOFT_MISO_PIN = 5;
const uint8_t SOFT_MOSI_PIN = 3;
const uint8_t SOFT_SCK_PIN = 2;

// SdFat software SPI template
SoftSpiDriver<SOFT_MISO_PIN, SOFT_MOSI_PIN, SOFT_SCK_PIN> softSpi;

#if ENABLE_DEDICATED_SPI
#define SD_CONFIG SdSpiConfig(SD_CS_PIN, DEDICATED_SPI, SD_SCK_MHZ(0), &softSpi)
#else  // ENABLE_DEDICATED_SPI
#define SD_CONFIG SdSpiConfig(SD_CS_PIN, SHARED_SPI, SD_SCK_MHZ(0), &softSpi)
#endif  // ENABLE_DEDICATED_SPI

#if SD_FAT_TYPE == 0
SdFat sd;
File file;
#elif SD_FAT_TYPE == 1
SdFat32 sd;
File32 file;
#elif SD_FAT_TYPE == 2
SdExFat sd;
ExFile file;
#elif SD_FAT_TYPE == 3
SdFs sd;
FsFile file;
#else  // SD_FAT_TYPE
#error Invalid SD_FAT_TYPE
#endif  // SD_FAT_TYPE

std::vector<std::string> fileList;
std::vector<std::vector<uint8_t>> bitmaps;

// Custom function to capture output of ls
void captureLsOutput(SdFile& dir, uint8_t flags) {
  dir.rewind();
  SdFile file;
  while (file.openNext(&dir, O_RDONLY)) {
    char name[100];
    file.getName(name, 100);
    std::string fileName(name);

    // Ensure the file is a regular file and not a directory
    if (!file.isDir() && fileName.size() >= 4 && fileName.substr(fileName.size() - 4) == ".txt" && fileName.substr(0, 2) != "._") {
      fileList.push_back(fileName);
    }

    if (flags & LS_R) {
      if (file.isDir()) {
        captureLsOutput(file, flags);
      }
    }
    file.close();
  }
}


// Function to parse hex values from a string
std::vector<uint8_t> parseHexValues(const std::string& content) {
  std::vector<uint8_t> values;
  std::stringstream ss(content);
  std::string token;
  while (std::getline(ss, token, ',')) {
    if (token.find("0x") != std::string::npos) {
      values.push_back(static_cast<uint8_t>(strtol(token.c_str(), nullptr, 16)));
    }
  }
  return values;
}

// Encoder variables
volatile int encoderPosition = 0;  // Used to track the rotary encoder position
volatile bool buttonPressed = false;  // Used to track the button press
volatile int lastEncoded = 0;  // Stores the last encoder value

bool sdCardPresent = false;

const uint8_t PROGMEM insertSDBitmaps[][1024] = {
{
  0xFF, 0xFF, 0xFF, 0xFF, 0xFF, 0xFF, 0xFF, 0xFF, 0xFF, 0x7F, 0x7F, 0x7F, 0x7F, 0xFF, 0x7F, 0x7F, 
  0x7F, 0x7F, 0xFF, 0xFF, 0x7F, 0x7F, 0xFF, 0xFF, 0x7F, 0x7F, 0xBF, 0x7F, 0x7F, 0x7F, 0xFF, 0xFF, 
  0x7F, 0x7F, 0x7F, 0x7F, 0x7F, 0x3F, 0xFF, 0xFF, 0x7F, 0x7F, 0x7F, 0xFF, 0x7F, 0x7F, 0x7F, 0xFF, 
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  0xFF, 0xFF, 0xFF, 0xFF, 0xFF, 0xFF, 0xFF, 0xFF, 0xFF, 0xFF, 0xFF, 0xFF, 0xFF, 0xFF, 0xFF, 0xFF, 
},
{
  0xFF, 0xFF, 0xFF, 0xFF, 0xFF, 0xFF, 0xFF, 0xFF, 0xFF, 0x7F, 0x7F, 0x7F, 0x7F, 0xFF, 0x7F, 0x7F, 
  0x7F, 0x7F, 0xFF, 0xFF, 0x7F, 0x7F, 0xFF, 0xFF, 0x7F, 0x7F, 0xBF, 0x7F, 0x7F, 0x7F, 0xFF, 0xFF, 
  0x7F, 0x7F, 0x7F, 0x7F, 0x7F, 0x3F, 0xFF, 0xFF, 0x7F, 0x7F, 0x7F, 0xFF, 0x7F, 0x7F, 0x7F, 0xFF, 
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  0xFF, 0xFF, 0xFF, 0xFF, 0xFF, 0xFF, 0xFF, 0xFF, 0xFF, 0xFF, 0xFF, 0xFF, 0xFF, 0xFF, 0xFF, 0xFF, 
},
{
  0xFF, 0xFF, 0xFF, 0xFF, 0xFF, 0xFF, 0xFF, 0xFF, 0xFF, 0x7F, 0x7F, 0x7F, 0x7F, 0xFF, 0x7F, 0x7F, 
  0x7F, 0x7F, 0xFF, 0xFF, 0x7F, 0x7F, 0xFF, 0xFF, 0x7F, 0x7F, 0xBF, 0x7F, 0x7F, 0x7F, 0xFF, 0xFF, 
  0x7F, 0x7F, 0x7F, 0x7F, 0x7F, 0x3F, 0xFF, 0xFF, 0x7F, 0x7F, 0x7F, 0xFF, 0x7F, 0x7F, 0x7F, 0xFF, 
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  0xFF, 0xFF, 0xFF, 0xFF, 0xFF, 0xFF, 0xFF, 0xFF, 0xFF, 0xFF, 0xFF, 0xFF, 0xFF, 0xFF, 0xFF, 0xFF, 
},
{
  0xFF, 0xFF, 0xFF, 0xFF, 0xFF, 0xFF, 0xFF, 0xFF, 0xFF, 0x7F, 0x7F, 0x7F, 0x7F, 0xFF, 0x7F, 0x7F, 
  0x7F, 0x7F, 0xFF, 0xFF, 0x7F, 0x7F, 0xFF, 0xFF, 0x7F, 0x7F, 0xBF, 0x7F, 0x7F, 0x7F, 0xFF, 0xFF, 
  0x7F, 0x7F, 0x7F, 0x7F, 0x7F, 0x3F, 0xFF, 0xFF, 0x7F, 0x7F, 0x7F, 0xFF, 0x7F, 0x7F, 0x7F, 0xFF, 
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  0xFF, 0xFF, 0xFF, 0xFF, 0xFF, 0xFF, 0xFF, 0xFF, 0xFF, 0xFF, 0xFF, 0xFF, 0xFF, 0xFF, 0xFF, 0xFF, 
},
{
  0xFF, 0xFF, 0xFF, 0xFF, 0xFF, 0xFF, 0xFF, 0xFF, 0xFF, 0x7F, 0x7F, 0x7F, 0x7F, 0xFF, 0x7F, 0x7F, 
  0x7F, 0x7F, 0xFF, 0xFF, 0x7F, 0x7F, 0xFF, 0xFF, 0x7F, 0x7F, 0xBF, 0x7F, 0x7F, 0x7F, 0xFF, 0xFF, 
  0x7F, 0x7F, 0x7F, 0x7F, 0x7F, 0x3F, 0xFF, 0xFF, 0x7F, 0x7F, 0x7F, 0xFF, 0x7F, 0x7F, 0x7F, 0xFF, 
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  0xFF, 0xFF, 0xFF, 0xFF, 0xFF, 0xFF, 0xFF, 0xFF, 0xFF, 0xFF, 0xFF, 0xFF, 0xFF, 0xFF, 0xFF, 0xFF, 
},
{
  0xFF, 0xFF, 0xFF, 0xFF, 0xFF, 0xFF, 0xFF, 0xFF, 0xFF, 0x7F, 0x7F, 0x7F, 0x7F, 0xFF, 0x7F, 0x7F, 
  0x7F, 0x7F, 0xFF, 0xFF, 0x7F, 0x7F, 0xFF, 0xFF, 0x7F, 0x7F, 0xBF, 0x7F, 0x7F, 0x7F, 0xFF, 0xFF, 
  0x7F, 0x7F, 0x7F, 0x7F, 0x7F, 0x3F, 0xFF, 0xFF, 0x7F, 0x7F, 0x7F, 0xFF, 0x7F, 0x7F, 0x7F, 0xFF, 
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  0xFF, 0xFF, 0xFF, 0xFF, 0xFF, 0xFF, 0xFF, 0xFF, 0xFF, 0xFF, 0xFF, 0xFF, 0xFF, 0xFF, 0xFF, 0xFF, 
},
{
  0xFF, 0xFF, 0xFF, 0xFF, 0xFF, 0xFF, 0xFF, 0xFF, 0xFF, 0xFF, 0xFF, 0xFF, 0xFF, 0xFF, 0xFF, 0xFF, 
  0xFF, 0xFF, 0xFF, 0xFF, 0xFF, 0xFF, 0xFF, 0xFF, 0xFF, 0xFF, 0xFF, 0xFF, 0xFF, 0xFF, 0xFF, 0xFF, 
  0xFF, 0xFF, 0xFF, 0xFF, 0xFF, 0xFF, 0xFF, 0xFF, 0xFF, 0xFF, 0xFF, 0xFF, 0xFF, 0xFF, 0x7F, 0x7F, 
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  0xFF, 0xFF, 0xFF, 0xFF, 0xFF, 0xFF, 0xFF, 0xFF, 0xFF, 0xFF, 0xFF, 0xFF, 0xFF, 0xFF, 0xFF, 0xFF, 
},
{
  0xFF, 0xFF, 0xFF, 0xFF, 0xFF, 0xFF, 0xFF, 0xFF, 0xFF, 0xFF, 0xFF, 0xFF, 0xFF, 0xFF, 0xFF, 0xFF, 
  0xFF, 0xFF, 0xFF, 0xFF, 0xFF, 0xFF, 0xFF, 0xFF, 0xFF, 0xFF, 0xFF, 0xFF, 0xFF, 0xFF, 0xFF, 0xFF, 
  0xFF, 0xFF, 0xFF, 0xFF, 0xFF, 0xFF, 0xFF, 0xFF, 0xFF, 0xFF, 0xFF, 0xFF, 0xFF, 0xFF, 0x7F, 0x7F, 
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  0xFF, 0xFF, 0xFF, 0xFF, 0xFF, 0xFF, 0xFF, 0xFF, 0xFF, 0xFF, 0xFF, 0xFF, 0xFF, 0xFF, 0xFF, 0xFF, 
}
};

void setup() {
  // Initialize Serial communication for debugging
  Serial.begin(9600);


  pinMode(ledPin, OUTPUT);
  pinMode(buttonPin, INPUT_PULLUP);
  digitalWrite(ledPin, LOW);


  // Initialize I2C
  Wire.setSDA(OLED_SDA);
  Wire.setSCL(OLED_SCL);
  Wire.begin();

  // Initialize the OLED display
  if (!display.begin(SSD1306_SWITCHCAPVCC, 0x3C)) {
    Serial.println(F("SSD1306 allocation failed"));
    for (;;);
  }

  // Clear the buffer
  display.clearDisplay();

  // Set text size and color
  display.setTextSize(1);
  display.setTextColor(SSD1306_WHITE);

  // Configure the rotary encoder pins with internal pull-up resistors
  pinMode(ROTARY_PIN_A, INPUT_PULLUP);
  pinMode(ROTARY_PIN_B, INPUT_PULLUP);
  pinMode(BUTTON_PIN, INPUT_PULLUP);

  // Attach interrupts to the encoder pins
  attachInterrupt(digitalPinToInterrupt(ROTARY_PIN_A), updateEncoder, CHANGE);
  attachInterrupt(digitalPinToInterrupt(ROTARY_PIN_B), updateEncoder, CHANGE);
  attachInterrupt(digitalPinToInterrupt(BUTTON_PIN), readButton, FALLING);

  // Try to initialize the SD card
  if (!sd.begin(SD_CONFIG)) {
    display.clearDisplay();
    drawBitmapPixelByPixel(insertSDBitmaps[0], SCREEN_WIDTH, SCREEN_HEIGHT);
    display.display();
    sdCardPresent = false;
  } else {
    sdCardPresent = true;
    loadFilesFromSD();
  }
}
bool isTakingPhoto = false; // Moved outside loop() for persistence

void loop() {
  int buttonState = digitalRead(buttonPin);

  // Check for button press
  if (buttonState == LOW && lastButtonState == HIGH) {
    digitalWrite(ledPin, HIGH);
    Serial.println("Button pressed, LED on");
    display.clearDisplay();

  // Set text size and color
  display.setTextSize(1);      // Normal 1:1 pixel scale
  display.setTextColor(SSD1306_WHITE); // Draw white text

  // Set the cursor position
  display.setCursor(0,0);     // Start at top-left corner
  
  // Print static text
  display.println(F("Taking photo..."));
  
  // Update the display with the buffer content
  display.display();    
    isTakingPhoto = true;
  } else if (buttonState == HIGH && lastButtonState == LOW) {
    digitalWrite(ledPin, LOW);
    Serial.println("Button released, LED off");

    // isTakingPhoto = false;

  }

  lastButtonState = buttonState; // Update the button state

  if (!isTakingPhoto) {
    bool currentSdCardState = sd.begin(SD_CONFIG);
    if (currentSdCardState != sdCardPresent) {
      sdCardPresent = currentSdCardState;
      if (!sdCardPresent) {
        display.clearDisplay();
        animateBitmaps();
      } else {
        loadFilesFromSD();
      }
    } else if (sdCardPresent) {
      displayImage();
    } else {
      animateBitmaps();
    }
  }

  delay(10);  // Check every 10 milliseconds
}


void animateBitmaps() {
  static uint8_t currentBitmapIndex = 0;
  currentBitmapIndex = (currentBitmapIndex + 1) % (sizeof(insertSDBitmaps) / sizeof(insertSDBitmaps[0]));
  display.clearDisplay();
  drawBitmapPixelByPixel(insertSDBitmaps[currentBitmapIndex], SCREEN_WIDTH, SCREEN_HEIGHT);
  display.display();
  delay(10);  // Stay on each slide for half a second
}



// Function to load files from SD card
void loadFilesFromSD() {
  // Open root directory
  if (!sd.chdir("/")) {
    sd.errorHalt("chdir failed");
  }

  // List all files in the root directory
  SdFile root;
  if (!root.open("/", O_READ)) {
    sd.errorHalt("open root failed");
  }

  captureLsOutput(root, LS_R);

  // Clear previous bitmaps
  bitmaps.clear();

  // Read content of each file in fileList and store in bitmaps
  for (const auto& fileName : fileList) {
    if (!file.open(fileName.c_str(), FILE_READ)) { // Open file for reading
      sd.errorHalt(F("open failed"));
    }

    // Read file content into a string
    std::string fileContent;
    while (file.available()) {
      fileContent += static_cast<char>(file.read());
    }

    file.close();

    // Parse hex values from file content
    std::vector<uint8_t> fileData = parseHexValues(fileContent);

    // Store the file data in bitmaps
    bitmaps.push_back(fileData);
  }

  // Print the contents of the buffer
  for (const auto& bitmap : bitmaps) {
    for (const auto& byte : bitmap) {
      Serial.write(byte);
    }
  }
}

// Function to draw a bitmap pixel by pixel
void drawBitmapPixelByPixel(const uint8_t* bitmap, int width, int height) {
  for (int y = 0; y < height; y++) {
    for (int x = 0; x < width; x++) {
      int byteIndex = x + (y / 8) * width;
      int bitIndex = y % 8;
      bool pixelOn = pgm_read_byte(&bitmap[byteIndex]) & (1 << bitIndex);
      display.drawPixel(x, y, pixelOn ? SSD1306_WHITE : SSD1306_BLACK);
    }
  }
}

// Function to display a bitmap based on encoder position
void displayImage() {
  // Clear the buffer
  display.clearDisplay();

  // Determine which bitmap to display based on encoder position
  uint8_t bitmapIndex = encoderPosition / 30;
  if (bitmapIndex >= bitmaps.size()) bitmapIndex = bitmaps.size() - 1;

  // Draw the bitmap pixel by pixel
  drawBitmapPixelByPixel(bitmaps[bitmapIndex].data(), SCREEN_WIDTH, SCREEN_HEIGHT);

  // Display everything on the screen
  display.display();
}

// Interrupt service routine to handle encoder state changes
void updateEncoder() {
  int MSB = digitalRead(ROTARY_PIN_A);  // MSB = most significant bit
  int LSB = digitalRead(ROTARY_PIN_B);  // LSB = least significant bit

  int encoded = (MSB << 1) | LSB;  // Combine the two bits
  int sum = (lastEncoded << 2) | encoded;  // Create a 4-bit state

  if (sum == 0b1101 || sum == 0b0100 || sum == 0b0010 || sum == 0b1011) encoderPosition++;
  if (sum == 0b1110 || sum == 0b0111 || sum == 0b0001 || sum == 0b1000) encoderPosition--;

  lastEncoded = encoded;  // Store this value for the next loop

  // Constrain encoder position to be between 0 and (number of bitmaps - 1) * 20
  if (encoderPosition < 0) encoderPosition = 0;
  if (encoderPosition >= bitmaps.size() * 20) encoderPosition = bitmaps.size() * 20 - 1;
}

// Interrupt service routine to handle button press
void readButton() {
  buttonPressed = true;

  // Just to acknowledge button press (you can use this if needed for future functionality)
  buttonPressed = false;
}

#else  // SPI_DRIVER_SELECT
#error SPI_DRIVER_SELECT must be two in SdFat/SdFatConfig.h
#endif  // SPI_DRIVER_SELECT
